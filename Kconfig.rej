## Kconfig.rej
```kconfig
--- Kconfig
+++ Kconfig
@@ -9,3 +9,4 @@ config SRCARCH
 	option env="SRCARCH"
 
 source "arch/$SRCARCH/Kconfig"
+source "backports/Kconfig"
```

## backports/Kconfig
```kconfig
config BACKPORT_INTEGRATE
	bool
	def_bool y

config BACKPORT_DIR
	string
	default "backports/"

config BACKPORT_VERSION
	string
	default "d13ca803"

config BACKPORT_KERNEL_VERSION
	string
	default "v4.2-0-g64291f7db5bd"

config BACKPORT_KERNEL_NAME
	string
	default "Linux"

menuconfig BACKPORT_LINUX
	bool "Backport Linux v4.2-0-g64291f7db5bd (backports d13ca803)"
	default n

if BACKPORT_LINUX

%%KCONFIG_VERSIONS%%

# this has the configuration for the backport code
source "$BACKPORT_DIR/compat/Kconfig"

# these are copied from the kernel
source "$BACKPORT_DIR/net/bluetooth/Kconfig"

source "$BACKPORT_DIR/net/6lowpan/Kconfig"
source "$BACKPORT_DIR/net/ieee802154/Kconfig"
source "$BACKPORT_DIR/net/mac802154/Kconfig"

endif # BACKPORT_LINUX
```
